## Firmware/system/br2_external/Config.in
```kconfig
source "$BR2_EXTERNAL_GATE_PATH/package/codec2/Config.in"
source "$BR2_EXTERNAL_GATE_PATH/package/rns/Config.in"
source "$BR2_EXTERNAL_GATE_PATH/package/lxmf/Config.in"
source "$BR2_EXTERNAL_GATE_PATH/package/nomadnet/Config.in"
source "$BR2_EXTERNAL_GATE_PATH/package/libcyaml/Config.in"
source "$BR2_EXTERNAL_GATE_PATH/package/rnode/Config.in"
source "$BR2_EXTERNAL_GATE_PATH/package/rns-page-node/Config.in"
source "$BR2_EXTERNAL_GATE_PATH/package/rs-reticulum/Config.in"
source "$BR2_EXTERNAL_GATE_PATH/package/rs-lxmf/Config.in"
source "$BR2_EXTERNAL_GATE_PATH/package/freedv-tnc/Config.in"
source "$BR2_EXTERNAL_GATE_PATH/package/direwolf/Config.in"
```

## Firmware/system/br2_external/configs/gate_zero_defconfig
```kconfig
BR2_arm=y
BR2_cortex_a7=y
BR2_ARM_FPU_VFPV4=y
BR2_TOOLCHAIN_BUILDROOT_CXX=y
BR2_CCACHE=y
BR2_GLOBAL_PATCH_DIR="board/orangepi/orangepi-zero/patches"
BR2_TARGET_GENERIC_HOSTNAME="rns_gate"
BR2_TARGET_GENERIC_ISSUE="Welcome to RNS-Gate"
BR2_ROOTFS_DEVICE_CREATION_DYNAMIC_EUDEV=y
BR2_TARGET_GENERIC_ROOT_PASSWD="123"
BR2_SYSTEM_DHCP="eth0"
BR2_ROOTFS_OVERLAY="$(BR2_EXTERNAL_GATE_PATH)/board/gate/linux/rootfs-overlay"
BR2_ROOTFS_POST_BUILD_SCRIPT="$(BR2_EXTERNAL_GATE_PATH)/board/gate/post-build.sh"
BR2_ROOTFS_POST_IMAGE_SCRIPT="$(BR2_EXTERNAL_GATE_PATH)/board/gate/post-image.sh"
BR2_ROOTFS_POST_SCRIPT_ARGS="-c $(BINARIES_DIR)/genimage.cfg"
BR2_LINUX_KERNEL=y
BR2_LINUX_KERNEL_CUSTOM_VERSION=y
BR2_LINUX_KERNEL_CUSTOM_VERSION_VALUE="6.6.3"
BR2_LINUX_KERNEL_USE_CUSTOM_CONFIG=y
BR2_LINUX_KERNEL_CUSTOM_CONFIG_FILE="$(BR2_EXTERNAL_GATE_PATH)/board/gate/linux/config"
BR2_LINUX_KERNEL_DTS_SUPPORT=y
BR2_LINUX_KERNEL_CUSTOM_DTS_PATH="$(BR2_EXTERNAL_GATE_PATH)/board/gate/linux/dts/allwinner/gate.dts"
BR2_LINUX_KERNEL_INSTALL_TARGET=y
BR2_LINUX_KERNEL_NEEDS_HOST_OPENSSL=y
BR2_PACKAGE_ALSA_UTILS=y
BR2_PACKAGE_ALSA_UTILS_AMIXER=y
BR2_PACKAGE_ALSA_UTILS_APLAY=y
BR2_PACKAGE_PULSEAUDIO=y
BR2_PACKAGE_PULSEAUDIO_DAEMON=y
BR2_PACKAGE_DOSFSTOOLS=y
BR2_PACKAGE_DOSFSTOOLS_FSCK_FAT=y
BR2_PACKAGE_MTD=y
BR2_PACKAGE_ARMBIAN_FIRMWARE=y
BR2_PACKAGE_ARMBIAN_FIRMWARE_XR819=y
BR2_PACKAGE_XR819_XRADIO=y
BR2_PACKAGE_PYTHON3=y
BR2_PACKAGE_PYTHON3_PYEXPAT=y
BR2_PACKAGE_PYTHON_SERIAL=y
BR2_PACKAGE_PYTHON_SPIDEV=y
BR2_PACKAGE_PYTHON_URWID=y
BR2_PACKAGE_GNUTLS=y
BR2_PACKAGE_LIBGPIOD=y
BR2_PACKAGE_LIBGPIOD_TOOLS=y
BR2_PACKAGE_LIBNDP=y
BR2_PACKAGE_NEWT=y
BR2_PACKAGE_READLINE=y
BR2_PACKAGE_IW=y
BR2_PACKAGE_LIGHTTPD=y
BR2_PACKAGE_LIGHTTPD_OPENSSL=y
BR2_PACKAGE_NTP=y
BR2_PACKAGE_NTP_SNTP=y
BR2_PACKAGE_NTP_NTPDATE=y
BR2_PACKAGE_NTP_NTPDC=y
BR2_PACKAGE_NTP_NTPQ=y
BR2_PACKAGE_NTP_NTPTIME=y
BR2_PACKAGE_NTP_TICKADJ=y
BR2_PACKAGE_OPENSSH=y
BR2_PACKAGE_WIRELESS_REGDB=y
BR2_PACKAGE_WIRELESS_TOOLS=y
BR2_PACKAGE_WIRELESS_TOOLS_LIB=y
BR2_PACKAGE_WPA_SUPPLICANT=y
BR2_PACKAGE_WPA_SUPPLICANT_AP_SUPPORT=y
BR2_PACKAGE_WPA_SUPPLICANT_AUTOSCAN=y
BR2_PACKAGE_WPA_SUPPLICANT_DEBUG_SYSLOG=y
BR2_PACKAGE_WPA_SUPPLICANT_CLI=y
BR2_PACKAGE_SCREEN=y
BR2_PACKAGE_UTIL_LINUX_LIBUUID=y
BR2_PACKAGE_UTIL_LINUX_RFKILL=y
BR2_PACKAGE_MC=y
BR2_PACKAGE_NANO=y
BR2_TARGET_ROOTFS_EXT2=y
BR2_TARGET_ROOTFS_EXT2_4=y
BR2_TARGET_ROOTFS_EXT2_SIZE="1G"
# BR2_TARGET_ROOTFS_TAR is not set
BR2_TARGET_UBOOT=y
BR2_TARGET_UBOOT_BUILD_SYSTEM_KCONFIG=y
BR2_TARGET_UBOOT_CUSTOM_VERSION=y
BR2_TARGET_UBOOT_CUSTOM_VERSION_VALUE="2023.10"
BR2_TARGET_UBOOT_BOARD_DEFCONFIG="orangepi_zero"
BR2_TARGET_UBOOT_NEEDS_DTC=y
BR2_TARGET_UBOOT_NEEDS_PYLIBFDT=y
BR2_TARGET_UBOOT_NEEDS_OPENSSL=y
BR2_TARGET_UBOOT_SPL=y
BR2_TARGET_UBOOT_SPL_NAME="u-boot-sunxi-with-spl.bin"
BR2_PACKAGE_HOST_DOSFSTOOLS=y
BR2_PACKAGE_HOST_GENIMAGE=y
BR2_PACKAGE_HOST_MTOOLS=y
BR2_PACKAGE_CODEC2=y
BR2_PACKAGE_RNODE=y
BR2_PACKAGE_RNS_PAGE_NODE=y
```

## Firmware/system/br2_external/package/direwolf/Config.in
```kconfig
config BR2_PACKAGE_DIREWOLF
    bool "Dire Wolf"
    select BR2_PACKAGE_ALSA_LIB
    select BR2_PACKAGE_LIBGPIOD
    help
      Dire Wolf TNC
```

## Firmware/system/br2_external/package/freedv-tnc/Config.in
```kconfig
config BR2_PACKAGE_FREEDV_TNC
    bool "FreeDV-TNC"
    select BR2_PACKAGE_LIBCYAML
    select BR2_PACKAGE_CODEC2
    select BR2_PACKAGE_ALSA_LIB
    select BR2_PACKAGE_FFTW
    select BR2_PACKAGE_FFTW_DOUBLE
    select BR2_PACKAGE_LIBGPIOD
    help
      FreeDV modem daemon
```

## Firmware/system/br2_external/package/lxmf/Config.in
```kconfig
config BR2_PACKAGE_LXMF
	bool "lxmf"
	select BR2_PACKAGE_RNS
	select BR2_PACKAGE_PYTHON_QRCODE
```

## Firmware/system/br2_external/package/nomadnet/Config.in
```kconfig
config BR2_PACKAGE_NOMADNET
	bool "nomadnet"
	select BR2_PACKAGE_LXMF
	select BR2_PACKAGE_PYTHON_URWID
```

## Firmware/system/br2_external/package/rnode/Config.in
```kconfig
config BR2_PACKAGE_RNODE
    bool "rnode"
    select BR2_PACKAGE_LIBCYAML
    help
      RNode SPI daemon
```
